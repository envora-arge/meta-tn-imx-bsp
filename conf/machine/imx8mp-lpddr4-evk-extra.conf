## conf/machine/imx8mp-lpddr4-evk-extra.conf
```bitbake
KERNEL_DEVICETREE:append = " \
	freescale/imx8mp-evk-tevs.dtb \
"
OVERRIDES:append = ":tn-camera"

# U-Boot persistent env: sets fdt_file on first boot via tn-uboot-fdt-setenv service
UBOOT_FDT_FILE = "imx8mp-evk-tevs.dtb"
IMAGE_FSTYPES:append = " ext4 wic.md5sum wic.xz wic.bz2"

#------ For Ubuntu ------
APTGET_EXTRA_PACKAGES:append:ubuntu = " libglu1-mesa"

#------ For VizionSDK/VizionViewer ------
LICENSE_FLAGS_ACCEPTED:append = " commercial_tn"
IMAGE_INSTALL:append = "tn-apt-list vizionsdk-dev vizionviewer"
APTGET_EXTRA_PACKAGES:append = " gnupg"

#------ For Ubuntu inspect V4L2 ------
APTGET_EXTRA_PACKAGES:append:ubuntu = " v4l-utils"
```
